
;;;;;;;;;;;;;;;;;;;;;;;;;;;;;;;;;;;;;
;;  GENERATED FILE - DO NOT EDIT
;;
;; generated:  Wed Dec 14 06:49:10 2016
;;;;;;;;;;;;;;;;;;;;;;;;;;;;;;;;;;;;;
global &NorTargetFamily
&NorTargetFamily="FLASH_8K_CORTEXA7_CFG"
global &NorMsmId
&NorMsmId="M8909"
global &NorCodeAddr
&NorCodeAddr=0x00200000
global &NorParamAddr
&NorParamAddr=0x0021E000
global &NorBootRomBegin
&NorBootRomBegin=
global &NorBootRomEnd
&NorBootRomEnd=
global &NorCodeRomBegin
&NorCodeRomBegin=0x00000000
global &NorCodeRomEnd
&NorCodeRomEnd=0xFFFFFFFF
global &NorConfigDir
&NorConfigDir="config_v1"
global &NorSrcRoot
&NorSrcRoot="../../../../../.."
global &UseTerm
&UseTerm="YES"
global &BuildId
&BuildId="DAATANAZA"
global &NorType
&NorType="I2C_NOR"
